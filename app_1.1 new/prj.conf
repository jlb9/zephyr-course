## CMakeLists.txt
```
cmake_minimum_required(VERSION 3.20.0)

list(APPEND BOARD_ROOT ${CMAKE_CURRENT_SOURCE_DIR})
list(APPEND ZEPHYR_EXTRA_MODULES ${CMAKE_CURRENT_SOURCE_DIR}/modules/led_sensor_module)

find_package(Zephyr REQUIRED)
project(my_zephyr_app)

target_sources(app PRIVATE
    src/main.cpp
    src/sensor_shell.c
)
target_include_directories(app PRIVATE modules/led_sensor_module/include)
```

## prj.conf
```kconfig
CONFIG_SENSOR=y
CONFIG_LED_SENSOR=y
CONFIG_GPIO=y
CONFIG_LOG=y

CONFIG_UART_CONSOLE=y
CONFIG_SHELL_BACKEND_SERIAL=y

CONFIG_SHELL=y
CONFIG_SHELL_CMDS=y
CONFIG_SHELL_TAB=y
CONFIG_SHELL_TAB_AUTOCOMPLETION=y
CONFIG_SHELL_HISTORY=y
```

## boards/nrf52840dk_nrf52840.overlay
```dts
/*
 * L7 Task 1 — nRF52840 DK board overlay
 *
 * Instantiates the iomico,led-sensor custom driver on LED0 (P0.13, active-low).
 * LED0 is the first of the four green LEDs on the nRF52840 DK (PCA10056).
 */

/ {
    led_sensor_0: led_sensor {
        compatible = "iomico,led-sensor";
        gpios = <&gpio0 13 GPIO_ACTIVE_LOW>;
        status = "okay";
    };

    aliases {
        led-sensor = &led_sensor_0;
    };
};
```

## src/main.cpp
```c
#include <zephyr/kernel.h>
#include <zephyr/device.h>
#include <zephyr/drivers/sensor.h>
#include <led_sensor/led_sensor.h>

#define LED_SENSOR_NODE DT_ALIAS(led_sensor)

int main(void)
{
    const struct device *dev = DEVICE_DT_GET(LED_SENSOR_NODE);

    if (!device_is_ready(dev)) {
        printk("LED sensor not ready\n");
        return -ENODEV;
    }

    led_sensor_set_message(dev, "heartbeat");

    printk("LED blinking (period %d ms). Shell: sensor fetch/read/info\n",
           CONFIG_APP_HEARTBEAT_PERIOD_MS);

    while (true) {
        struct sensor_value val;
        int ret;

        ret = sensor_sample_fetch(dev);
        if (ret < 0) {
            printk("sample_fetch failed: %d\n", ret);
            k_msleep(CONFIG_APP_HEARTBEAT_PERIOD_MS);
            continue;
        }
        k_msleep(CONFIG_APP_HEARTBEAT_PERIOD_MS / 2);

        ret = sensor_channel_get(dev, SENSOR_CHAN_ALL, &val);
        if (ret < 0) {
            printk("channel_get failed: %d\n", ret);
            k_msleep(CONFIG_APP_HEARTBEAT_PERIOD_MS);
            continue;
        }
        k_msleep(CONFIG_APP_HEARTBEAT_PERIOD_MS / 2);
    }

    return 0;
}
```

## src/sensor_shell.c
```c
#include <zephyr/shell/shell.h>
#include <zephyr/drivers/sensor.h>
#include <zephyr/device.h>

static const struct device *get_led_sensor(void)
{
    return DEVICE_DT_GET(DT_ALIAS(led_sensor));
}

/* --- fetch: turns the LED on --- */
static int cmd_sensor_fetch(const struct shell *sh, size_t argc, char **argv)
{
    const struct device *dev = get_led_sensor();

    if (!device_is_ready(dev)) {
        shell_error(sh, "Sensor not available");
        return -ENODEV;
    }

    int ret = sensor_sample_fetch(dev);
    if (ret) {
        shell_error(sh, "fetch failed: %d", ret);
        return ret;
    }

    shell_print(sh, "fetch OK - LED on");
    return 0;
}

/* --- read: turns the LED off and prints the result --- */
static int cmd_sensor_read(const struct shell *sh, size_t argc, char **argv)
{
    const struct device *dev = get_led_sensor();

    if (!device_is_ready(dev)) {
        shell_error(sh, "Sensor not available");
        return -ENODEV;
    }

    struct sensor_value val;
    int ret = sensor_channel_get(dev, SENSOR_CHAN_ALL, &val);
    if (ret) {
        shell_error(sh, "channel_get failed: %d", ret);
        return ret;
    }

    shell_print(sh, "read OK - LED off, val=%d.%06d", val.val1, val.val2);
    return 0;
}

/* --- info: prints device name and status --- */
static int cmd_sensor_info(const struct shell *sh, size_t argc, char **argv)
{
    const struct device *dev = get_led_sensor();

    shell_print(sh, "Device name : %s", dev->name);
    shell_print(sh, "Device ready: %s", device_is_ready(dev) ? "YES" : "NO");
    return 0;
}

/* --- subcommand registration and root command --- */
SHELL_STATIC_SUBCMD_SET_CREATE(sub_sensor,
    SHELL_CMD(fetch, NULL, "Fetch sensor sample (LED ON)", cmd_sensor_fetch),
    SHELL_CMD(read,  NULL, "Read sensor channel (LED OFF)", cmd_sensor_read),
    SHELL_CMD(info,  NULL, "Print device info", cmd_sensor_info),
    SHELL_SUBCMD_SET_END
);

SHELL_CMD_REGISTER(sensor, &sub_sensor, "LED sensor commands", NULL);
```
