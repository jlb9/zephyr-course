/ {
    chosen {
        zephyr,console   = &uart0;
        zephyr,shell-uart = &uart0;
    };
    led_sensor: led-sensor {
        compatible = "custom,led-sensor";
        gpios = <&gpio1 38 GPIO_ACTIVE_HIGH>;
        status = "okay";
    };
};