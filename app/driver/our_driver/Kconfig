## app/driver/our_driver/Kconfig
```kconfig
config OUR_DRIVER
	bool "Our Driver"
	default y
	depends on DT_HAS_IOMICO_OUR_DRIVER_ENABLED
	select SENSOR
	help
	  Enable the custom iomico,our-driver sensor used by this application.
```

## everthing course/zephyr-course-l8-task2.1/zephyr-course-l8-task2/drivers/dts/bindings/sensor/custom,led-sensor.yaml
```yaml
description: LED Sensor

compatible: "custom,led-sensor"

include: base.yaml

properties:
  gpios:
    type: phandle-array
    required: true
    description: GPIO connected to the LED used as a sensor output
```

## everthing course/zephyr-course-l8-task2.1/zephyr-course-l8-task2/drivers/sensor/led_sensor/Kconfig
```kconfig
config LED_SENSOR
	bool "LED Sensor Driver"
	default y
	select SENSOR
	help
	  Enable the custom LED sensor driver. Calling sensor_sample_fetch
	  turns the LED on; calling sensor_channel_get turns the LED off.
```
