## app/boards/my_board/Kconfig.defconfig
```kconfig
# SPDX-License-Identifier: Apache-2.0

if BOARD_MY_BOARD

config HW_STACK_PROTECTION
	default ARCH_HAS_STACK_PROTECTION

endif # BOARD_MY_BOARD
```

## app/boards/our_board/Kconfig.defconfig
```kconfig
# nRF52840 DK NRF52840 board configuration

# Copyright (c) 2016 Nordic Semiconductor ASA
# SPDX-License-Identifier: Apache-2.0

if BOARD_OUR_BOARD

config HW_STACK_PROTECTION
	default ARCH_HAS_STACK_PROTECTION

endif # BOARD_OUR_BOARD
```

## app/boards/our_board/board.yml
```yaml
board:
  name: our_board
  full_name: Our Board
  vendor: nordic
  socs:
    - name: nrf52840
```

## everthing course/zephyr-course-l8-task1/boards/mumo_v2/board.yml
```yaml
board:
  name: mumo_v2
  full_name: MuMo v2
  vendor: strooom
  socs:
    - name: stm32wle5xx
```

## everthing course/zephyr-course-l8-task1/boards/toolsquare/Kconfig.toolsquare
```kconfig
config BOARD_TOOLSQUARE
	select SOC_ESP32_WROOM_32UE_N16
	select SOC_ESP32_PROCPU if BOARD_TOOLSQUARE_ESP32_PROCPU
	select SOC_ESP32_APPCPU if BOARD_TOOLSQUARE_ESP32_APPCPU
```

## everthing course/zephyr-course-l8-task1/boards/toolsquare/board.yml
```yaml
board:
  name: toolsquare
  full_name: Toolsquare Control Unit
  vendor: Toolsquare
  socs:
  - name: esp32
```

## everthing course/zephyr-course-l8-task1/dts/bindings/strooom,l6driver.yaml
```yaml
description: custom driver for lesson 6 assignment
compatible: "strooom,l6driver"      # this value should match the name of the file (without the .yaml extension) and the compatible string used in the device tree
include: base.yaml
properties:
  calibration:
    type: int
    required: true
    description: Calibration value for the sensor
  sleep-ms:
    type: int
    required: true
    description: Duration in milliseconds for k_msleep calls in the driver
  gpios:
    type: phandle-array
    required: true
    description: GPIO spec for the LED to control
```

## everthing course/zephyr-course-l8-task1/west.yml
```yaml
manifest:
  version: 1.0
  self:
    path: app

  projects:
    - name: zephyr
      url: https://github.com/zephyrproject-rtos/zephyr
      revision: v4.4.0
      import:
        name-allowlist:
          - cmsis_6
          - hal_stm32
          - hal_espressif
          - segger
```

## everthing course/zephyr-course-l8-task2/boards/mumo_v2/mumo_v2_defconfig
```kconfig
CONFIG_SERIAL=y
CONFIG_GPIO=y
CONFIG_CONSOLE=y
CONFIG_UART_CONSOLE=y
CONFIG_ARM_MPU=y
CONFIG_HW_STACK_PROTECTION=y
CONFIG_I2C=y
CONFIG_SENSOR=y
CONFIG_BME680=y
```

## everthing course/zephyr-course-l8-task2/boards/toolsquare/Kconfig
```kconfig
config HEAP_MEM_POOL_ADD_SIZE_BOARD
	int
	default 4096 if BOARD_TOOLSQUARE_ESP32_PROCPU
	default 256 if BOARD_TOOLSQUARE_ESP32_APPCPU
```

## everthing course/zephyr-course-l8-task2/drivers/l6driver/Kconfig
```kconfig
config L6DRIVER
    bool "Lesson 6 Custom Driver Assignment"
    default y                                           # default is enabled...
    depends on DT_HAS_STROOOM_L6DRIVER_ENABLED          # ...but only if some hardware uses it
    help
        enable/disable the custom driver for lesson 6 assignment
```

## everthing course/zephyr-course-l8-task2/lib/breathing_led/Kconfig
```kconfig
# Kconfig - Breathing LED Library

config BREATHING_LED
    bool "Enable breathing LED"
    default n
    help
      Enable the breathing LED library, which fades a LED in and out
      continuously to produce a breathing effect. It uses either a PWM led, or  WS2818 led.

if BREATHING_LED

config BREATHING_LED_CYCLE_MS
    int "Breathing cycle time in milliseconds"
    default 1000
    range 500 3000
    help
      Duration of one full breathing cycle (fade in + fade out) in
      milliseconds. Valid range is 500 ms (2 Hz) to 3000 ms (0.33 Hz).

choice BREATHING_LED_TYPE
    prompt "Breathing LED type"
    default BREATHING_LED_TYPE_PWM
    help
      Select the type of LED used for the breathing effect.

config BREATHING_LED_TYPE_PWM
    bool "Standard LED with PWM"
    depends on PWM
    help
      Use a standard LED driven by a PWM output.

config BREATHING_LED_TYPE_WS2812
    bool "WS2812 RGB LED"
    depends on LED_STRIP
    help
      Use a WS2812 addressable RGB LED for the breathing effect.

endchoice

if BREATHING_LED_TYPE_WS2812

choice BREATHING_LED_COLOR
    prompt "Breathing color"
    default BREATHING_LED_COLOR_WHITE
    help
      Select the color used for the WS2812 breathing effect.

config BREATHING_LED_COLOR_WHITE
    bool "White"

config BREATHING_LED_COLOR_RED
    bool "Red"

config BREATHING_LED_COLOR_GREEN
    bool "Green"

config BREATHING_LED_COLOR_BLUE
    bool "Blue"

config BREATHING_LED_COLOR_CYAN
    bool "Cyan"

config BREATHING_LED_COLOR_MAGENTA
    bool "Magenta"

config BREATHING_LED_COLOR_YELLOW
    bool "Yellow"

endchoice

endif # BREATHING_LED_TYPE_WS2812

endif # BREATHING_LED
```
